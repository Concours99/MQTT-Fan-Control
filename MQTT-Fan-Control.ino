// Arduino IDE info:
//     Board: LOLIN/(WEMOS) D1 Mini (clone)
//
// Original version from:
// https://github.com/owenb321/hampton-bay-fan-mqtt/blob/master/hampton_bay_fan_mqtt/hampton_bay_fan_mqtt.ino
//
// Some additional help from
// https://www.richardn.ca/posts/CeilingFanRemoteHacking/ 
//
// An additional implementation here:
// https://github.com/patrickdk77/hampton-bay-fan-mqtt
//
// Changes made for local deployment
// by: Wayne Geiser (geiserw@gmail.com)
// Initial changes: 2024-March-13
//#########################################################################
// 2025-January-18 changes
// 1. Send RF 4 times with a 15 second delay to ensure it is received
// 2. Add code to handle new mqtt topics for light brightness (at the moment only 0, 50, 100)
// 3. Added a name for this device and changed the SSID to the IoT network
// 2025-January-27 changes
// 1. complete rewrite with a simpler interface (just two mqtt topics, 1 for light and 1 for speed)
// 2025-August-10 changes
// 1. Thanks to "Blazer the Laser" for decoding the light brightness levels
//
#include <ELECHOUSE_CC1101_SRC_DRV.h>
#include <RCSwitch.h>
#include <ESP8266WiFi.h>
#include <PubSubClient.h>
#include "SecretStuff.h" // WiFi and MQTT definitions I don't want to expose

// Configure MQTT broker settings
#define MQTT_CLIENT_NAME "FamilyRoomFanController"
#define BASE_TOPIC "homeassistant/familyroomfan"

#define SUBSCRIBE_TOPIC_SPEED "homeassistant/familyroomfan/speed" // off, low, medium, hight
#define SUBSCRIBE_TOPIC_LIGHT "homeassistant/familyroomfan/light" // %

// Set receive and transmit pin numbers (GDO0 and GDO2)
#ifdef ESP32 // for esp32! Receiver on GPIO pin 4. Transmit on GPIO pin 2.
  #define RX_PIN 4 
  #define TX_PIN 2
#elif ESP8266  // for esp8266! Receiver on pin 4 = D2. Transmit on pin 5 = D1.
  #define RX_PIN 4
  #define TX_PIN 5
#else // for Arduino! Receiver on interrupt 0 => that is pin #2. Transmit on pin 6.
  #define RX_PIN 0
  #define TX_PIN 6
#endif 

// Set CC1101 frequency (some possibilities)
// 303.631 determined from FAN-9T remote tramsmissions
// 303.85 determined from FCC id: CHQ8BT7096T on rear of remote
// 303.875 from https://www.richardn.ca/posts/CeilingFanRemoteHacking/ project
// 303.904 from https://www.laser.com/dhouston/frequency.html using FCC id: CHQ8BT7096T
#define FREQUENCY 303.85                                                                                 

// RC-switch settings
#define RF_PROTOCOL 6
#define RF_REPEATS  8

// Define fan states
#define FAN_OFF 0
#define FAN_HI  1
#define FAN_MED 2
#define FAN_LOW 3

#define RFnumTransmits 3 // Number of times to transmit RF code
#define RFTransmitDelay 5000 // 5 seconds

const char *fanStateTable[4] = {
  "off", "high", "medium", "low"
};

RCSwitch mySwitch = RCSwitch();
WiFiClient espClient;
PubSubClient client(espClient);

int long value;      // int to save value
int bits;           // int to save bit number
int prot;          // int to save Protocol number

// Keep track of states for all dip settings
struct fan
{
  uint8_t light;
  uint8_t speed;
};
fan myfan;


// The ID returned from the RF code appears to be inversed and reversed
//   e.g. a dip setting of on off off off (1000) yields 1110
// Convert between IDs from MQTT from dip switch settings and what is used in the RF codes
const byte dipToRfIds[16] = {
    [ 0] = 15, [ 1] = 7, [ 2] = 11, [ 3] = 3,
    [ 4] = 13, [ 5] = 5, [ 6] =  9, [ 7] = 1,
    [ 8] = 14, [ 9] = 6, [10] = 10, [11] = 2,
    [12] = 12, [13] = 4, [14] =  8, [15] = 0,
};
const char *idStrings[16] = {
    [ 0] = "0000", [ 1] = "0001", [ 2] = "0010", [ 3] = "0011",
    [ 4] = "0100", [ 5] = "0101", [ 6] = "0110", [ 7] = "0111",
    [ 8] = "1000", [ 9] = "1001", [10] = "1010", [11] = "1011",
    [12] = "1100", [13] = "1101", [14] = "1110", [15] = "1111",
};
char idchars[] = "01";

void setup_wifi() {

  delay(10);
  // We start by connecting to a WiFi network
  Serial.println();
  Serial.print("Connecting to ");
  Serial.println(SECRET_SSID);

  String hostname = "FanRFControl";
  WiFi.mode(WIFI_STA);
  WiFi.setHostname(hostname.c_str());
  WiFi.begin(SECRET_SSID, SECRET_PASS);

  while (WiFi.status() != WL_CONNECTED) {
    delay(500);
    Serial.print(".");
  }

  randomSeed(micros());

  Serial.println("");
  Serial.println("WiFi connected");
  Serial.println("IP address: ");
  Serial.println(WiFi.localIP());
}

// The following procedure was generated by zzzcode.at
int calculateChecksum(int number) {
  int sum = 0;
  
  while (number > 0) {
    sum += number & 0xF;
    number >>= 4;
  }
  
  return sum % 16;
}

int lightBrightnessConvertPctToXmit(int value) {
  if (value == 0) {
    return 0;
  } else if (value == 100) {
    return 1;
  } else {
    // Blazer the Laser used the map() function to do the following conversion.
    // I didn't like the way it mapped.  For example, 1 and 2 should be 50.  map() also made 3 and 4 map to 50.
    return 50 - round((((float) value - 1.0) * 48.0) / 98.0); // Maps 1->50, 99->2
  }
}

void transmitState(int fanId) {
  ELECHOUSE_cc1101.SetTx();           // set Transmit on
  mySwitch.disableReceive();         // Receiver off
  mySwitch.enableTransmit(TX_PIN);   // Transmit on
  mySwitch.setRepeatTransmit(RF_REPEATS); // transmission repetitions.
  mySwitch.setProtocol(RF_PROTOCOL);        // send Received Protocol

  // Determine light and fan component of RF code
  int fanRf = myfan.speed;
  // Determine light component of RF code
  int lightRf = lightBrightnessConvertPctToXmit(myfan.light);
  // Build out RF code
  //   Code follows the 21 bit pattern
  //   000xxxxyyyyyyyzzccccc
  //   Where
  //     x is the inversed/reversed dip setting, 
  //     y is light state (0 is off, otherwise it is a value from 1 (100%) to 50 (1%))
  //     z is fan speed
  //	   c is the checksum
  int rfCode = dipToRfIds[fanId] << 9 | lightRf << 2 | fanRf;
  rfCode = rfCode << 5 | calculateChecksum(rfCode);
  
  Serial.print("Dip switches = ");
  Serial.print(dipToRfIds[fanId]);
  Serial.print(" speed = ");
  Serial.print(fanRf);
  Serial.print(" light = ");
  Serial.println(lightRf);

  mySwitch.send(rfCode, 21);      // send 21 bit code
  Serial.print("Sending rfCode: ");
  Serial.println(rfCode);
  mySwitch.disableTransmit();   // set Transmit off
}

void callback(char* topic, byte* payload, unsigned int length) {
  char payloadchar[length + 1];
  Serial.print("Message arrived [");
  Serial.print(topic);
  Serial.print("] ");
  for (int i = 0; i < length; i++) {
    Serial.print((char)payload[i]);
    payloadchar[i] = payload[i];
  }
  payloadchar[length] = '\0';
  Serial.print(" (");
  Serial.print(payloadchar);
  Serial.println(")");

  if(strcmp(topic, SUBSCRIBE_TOPIC_SPEED) == 0) {
    Serial.print("Fan speed being set to ");
    if(((String) payloadchar).startsWith("low")) {
      myfan.speed = FAN_LOW;
      Serial.print("low (");
    }
    else if(((String) payloadchar).startsWith("medium")) {
      myfan.speed = FAN_MED;
      Serial.print("medium (");
    }
    else if(((String) payloadchar).startsWith("high")) {
      myfan.speed = FAN_HI;
      Serial.print("high (");
    }
    else if(((String) payloadchar).startsWith("off")) {
      myfan.speed = FAN_OFF;
      Serial.print("off (");
    }
    Serial.print(myfan.speed);
    Serial.println(")");
  }
  else if(strcmp(topic, SUBSCRIBE_TOPIC_LIGHT) == 0) {
    myfan.light = ((String) payloadchar).toInt();
    Serial.print("Fan light being set to ");
    Serial.println(myfan.light);
}
  else {
    // Unknown topic
    return;
  }
  transmitState(10); // hardwired my fan ID
}

void reconnect() {
  // Loop until we're reconnected
  while (!client.connected()) {
    Serial.print("Attempting MQTT connection...");
    // Attempt to connect
    if (client.connect(MQTT_CLIENT_NAME, SECRET_MQTT_USER, SECRET_MQTT_PASS)) {
      Serial.println("connected");
      client.subscribe(SUBSCRIBE_TOPIC_SPEED);
      client.subscribe(SUBSCRIBE_TOPIC_LIGHT);
    } else {
      Serial.print("failed, rc=");
      Serial.print(client.state());
      Serial.println(" try again in 5 seconds");
      // Wait 5 seconds before retrying
      delay(5000);
    }
  }
}

void setup() {
  Serial.begin(9600);

  // initialize fan struct
  myfan.light = 0;
  myfan.speed = FAN_OFF;

  ELECHOUSE_cc1101.Init();
  ELECHOUSE_cc1101.setMHZ(FREQUENCY);
  ELECHOUSE_cc1101.SetRx();
  mySwitch.enableReceive(RX_PIN);

  setup_wifi();
  client.setServer(SECRET_MQTT_BROKER_IP_LOCAL, SECRET_MQTT_PORT);
  client.setCallback(callback);
}

void loop() {

  if (!client.connected()) {
    reconnect();
  }
  client.loop();
}
